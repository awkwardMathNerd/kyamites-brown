## Kconfig.kyamites-brown
```kconfig
###############################################################
# @file Kconfig.kyamites-brown
# @author Lachlan Smith - s4482220
# @date 08032021
# @brief The Methane Project
###############################################################

rsource "drivers/Kconfig"
```

## app/client/Kconfig
```kconfig
###############################################################
# @file apps/project/Kconfig
# @author Lachlan Smith - s4482220
# @date 08032021
# @brief Project
###############################################################

rsource "../../mylib/Kconfig.mylib"
source "Kconfig.zephyr"
```

## app/relay/Kconfig
```kconfig
###############################################################
# @file app/relay/Kconfig
# @author Lachlan Smith - s4482220
# @date 08032021
# @brief Project
###############################################################

source "Kconfig.zephyr"
```

## drivers/crickit/Kconfig
```kconfig
menuconfig SHIELD_CRICKIT
    bool "Configure adafruit crickit shield"
    depends on I2C

if SHIELD_CRICKIT

config SHIELD_CRICKIT_GPIO
    bool "Configure general purpose I/O"

config SHIELD_CRICKIT_SERCOM
    bool "Configure serial communication"

config SHIELD_CRICKIT_NEOPIXEL
    bool "Configure general purpose I/O"

config SHIELD_CRICKIT_TOUCH
    bool "Configure touch"

config SHIELD_CRICKIT_KEYPAD
    bool "Configure general purpose I/O"

config SHIELD_CRICKIT_ENCODER
    bool "Configure encoder"

endif
```

## dts/bindings/adafruit,crickit.yaml
```yaml
description: Adafruit CRICKIT shield

compatible: "adafruit,crickit"

include: [i2c-device.yaml, gpio-controller.yaml]

properties:
    label:
      required: true

    "#gpio-cells":
      const: 2

    ngpios:
      required: true
      const: 16
```

## dts/bindings/power-timer.yaml
```yaml
description: Power timing board GPIO Controller

compatible: "power-timer"

properties:
  gpios:
    type: phandle-array
    required: true
    description: |
      GPIO to use to enable/disable the regulator.

      Unlike the gpio property in the Linux bindings this array must
      provide the GPIO polarity and open-drain status in the phandle
      selector.  The Linux enable-active-high and gpio-open-drain
      properties are not valid for Zephyr devicetree files.
```

## subsys/bluetooth/mesh/Kconfig
```kconfig
#
# Copyright (c) 2019 Nordic Semiconductor ASA
#
# SPDX-License-Identifier: LicenseRef-Nordic-5-Clause
#

if BT_MESH

config BT_MESH_MOD_ACKD_TIMEOUT_BASE
	int "The base timeout for acknowledged messages"
	default 3000
	help
	  The base timeout in milliseconds that the model waits for the response
	  if it is required. The response is typically a status message.
	  Mesh Profile recommends the waiting time a minimum of 30 seconds.

config BT_MESH_MOD_ACKD_TIMEOUT_PER_HOP
	int "The per hop timeout for acknowledged messages"
	default 50
	help
	  The timeout in milliseconds that the model adds per hop
	  to the base response time.

config BT_MESH_SENSOR
	bool

config BT_MESH_SENSOR_LABELS
	bool "Enable Sensor labels"
	help
	  Controls the availability of sensor labels for channels and units

config BT_MESH_SENSOR_ALL_TYPES
	bool "Force all sensor types to be known"
	default y if BT_MESH_SENSOR_CLI
	help
	  Forces all sensor types to be included in the build. This is
	  useful if the set of sensor types that will be used is unknown at
	  compile time, but increases ROM usage by about 3.5kB (4kB if labels
	  are enabled).

config BT_MESH_SENSOR_CHANNELS_MAX
	int "Max sensor channels"
	default 5
	help
	  Max number of channels in a single sensor. Matches the largest known
	  number by default.

config BT_MESH_SENSOR_CHANNEL_ENCODED_SIZE_MAX
	int "Max sensor channel encoded length"
	default 4
	help
	  Longest encoded representation of a single sensor channel.
	  Matches the largest known size by default.

menuconfig BT_MESH_SENSOR_SRV
	bool "Sensor Server"
	select BT_MESH_SENSOR
	help
	  Enable mesh Sensor Server model.

if BT_MESH_SENSOR_SRV

config BT_MESH_SENSOR_SRV_SENSORS_MAX
	int "Max number of sensors per server"
	default 4
	range 1 189
	help
	  The upper boundary of a Sensor Server's sensor count.


config BT_MESH_SENSOR_SRV_SETTINGS_MAX
	int "Max setting parameters per sensor in a server"
	default 8
	range 0 189
	help
	  Max number of settings parameters each sensor in the
	  server can have. Only affects the stack allocated response buffer
	  for the Settings Get message.

endif

config BT_MESH_SENSOR_CLI
	bool "Sensor Client"
	select BT_MESH_SENSOR
	help
	  Enable mesh Sensor Client model.

endif
```

## subsys/bluetooth/mesh/boards/Kconfig
```kconfig
config BT_MESH_BOARD_ARGON_PROV
    bool "Configure provision on particle argon"
    depends on BT_MESH
```

## west.yml
```yaml
# Dependant on the west manifest file for upstream Zephyr.
# Zephyr revision should only point to an official release commit.
#
# Only imports subprojects currently required to minimise cloning time.

manifest:
  defaults:
    remote: upstream

  remotes:
    - name: upstream
      url-base: https://github.com/zephyrproject-rtos

  projects:
    - name: zephyr
      repo-path: zephyr
      revision: fe7c2efca800a0cf1bccf23aefe08b3c4beb88bf
      import:
        name-whitelist:
          - cmsis
          - hal_nordic
          - hal_stm32
          - mbedtls
          - mcuboot
          - mcumgr
          - segger
          - tinycbor
          - tinycrypt
          - loramac-node

  self:
    path: kyamites-brown
    west-commands: scripts/west-commands.yml
```
